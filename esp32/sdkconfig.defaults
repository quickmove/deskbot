## esp32/sdkconfig.defaults
```kconfig
# ESP32 Configuration
CONFIG_IDF_TARGET="esp32"

# WiFi - set your credentials here
CONFIG_ESP_WIFI_SSID="your_wifi_ssid"
CONFIG_ESP_WIFI_PASSWORD="your_wifi_password"

# Console
CONFIG_ESP_CONSOLE_UART_DEFAULT=y

# Log
CONFIG_LOG_DEFAULT_LEVEL_INFO=y

# FreeRTOS
CONFIG_FREERTOS_HZ=1000

# WiFi
CONFIG_ESP_WIFI_ENABLED=y
```
